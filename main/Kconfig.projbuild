## main/Kconfig.projbuild
```kconfig
menu "App Configuration"
    
    rsource "../$(MY_ESP_LIBRARIES_PATH)/provision/provision.projbuild"  
    rsource "../$(MY_ESP_LIBRARIES_PATH)/mqtt_tools/mqtt.projbuild"

    menu "Sensors"
        rsource "../$(MY_ESP_LIBRARIES_PATH)/sensors/adc.projbuild"
        rsource "../$(MY_ESP_LIBRARIES_PATH)/sensors/bme680.projbuild"
        rsource "../$(MY_ESP_LIBRARIES_PATH)/sensors/bh1750.projbuild"
        
    endmenu

    menu "Battery"
        config BATTERY_MAX
            int "value 100% (4.2V)"
            default 2940
        config BATTERY_MIN
            int "value 0%(3.0V)"
            default 2053
    endmenu

    menu "Deep Sleep"
        config DEEP_SLEEP_ENABLED
            bool "Enable Deep Sleep"
            default y
        config DEEP_SLEEP_TIMEOUT_S
            int "Deep Sleep timeout (sec)"
            default 7
        config DEEP_SLEEP_DURATION_S
            int "Deep Sleep duration (sec)"
            default 900
        config DEEP_SLEEP_LOWBAT
            int "value in % recognised as low bat"
            default 30
        config DEEP_SLEEP_LOWBAT_DURATION_S
            int "Deep Sleep duration when LOW BAT(sec)"
            default 1800
    endmenu

endmenu
```
